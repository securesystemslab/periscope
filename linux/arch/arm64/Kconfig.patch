## linux/arch/arm64/Kconfig.patch
```kconfig
diff --git a/arch/arm64/Kconfig b/arch/arm64/Kconfig
index c520b0d107fb..d5a0400b685f 100644
--- a/arch/arm64/Kconfig
+++ b/arch/arm64/Kconfig
@@ -283,6 +283,24 @@ endmenu
 
 menu "Kernel Features"
 
+config KHWIO_STREAMING_DMA
+	depends on HWIOTRACE
+	bool "trace streaming dma"
+	help
+	  Support streaming dma tracing
+
+config KHWIO_CONSISTENT_DMA
+	depends on HWIOTRACE
+	bool "trace consistent dma"
+	help
+	  Support consistent dma tracing
+
+config KHWIO_MMIO
+	depends on HWIOTRACE
+	bool "trace mmio"
+	help
+	  Support memory mapped io tracing
+
 menu "ARM errata workarounds via the alternatives framework"
 
 config ARM64_ERRATUM_826319
```

## linux/kernel/trace/Kconfig.patch
```kconfig
diff --git a/kernel/trace/Kconfig b/kernel/trace/Kconfig
index fc08ba9c1ed9..75941191c79c 100644
--- a/kernel/trace/Kconfig
+++ b/kernel/trace/Kconfig
@@ -572,6 +572,26 @@ config MMIOTRACE_TEST
 
 	  Say N, unless you absolutely know what you are doing.
 
+config HWIOTRACE
+	bool "HW IO tracing"
+	depends on PCI
+	select GENERIC_TRACER
+	help
+	  Hwiotrace traces HW I/O access and is meant for testing.
+	  Tracing is disabled by default and can be enabled at run-time.
+
+	  If you are not helping to develop drivers, say N.
+
+config HWIOFUZZ
+	bool "HW IO fuzzing"
+	depends on PCI
+	select GENERIC_TRACER
+	help
+	  Hwiofuzz fuzzes HW I/O access and is meant for testing.
+	  Fuzzing is disabled by default and can be enabled at run-time.
+
+	  If you are not helping to develop drivers, say N.
+
 config TRACEPOINT_BENCHMARK
         bool "Add tracepoint that benchmarks tracepoints"
 	help
```
